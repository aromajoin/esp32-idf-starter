## main/Kconfig.projbuild
```kconfig
menu "Starter configuration"
  config DEFAULT_DEVICE_NAME
    string "Device Name"
    default "ESP32-Starter"
    help
      User's config device name string.
endmenu
```
